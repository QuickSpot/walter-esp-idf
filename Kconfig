## Kconfig
```kconfig
menu "walter-modem"
    config WALTER_MODEM_KCONFIG
            bool "Enable Kconfig"
            default y
            help
                enable Kconfig for Walter Modem.

    if WALTER_MODEM_KCONFIG
        menu "Events"
            config WALTER_MODEM_EVENT_QUEUE_MAX_ITEMS
                int "Max queued events"
                range 1 32
                default 8
                help
                    The maximum number of events that can be queued.
            
            config WALTER_MODEM_EVENT_TASK_STACK_SIZE
                int "Event task stack size"
                default 8192
                help
                    The stack size of the event handling task.

            config WALTER_MODEM_MAX_EVENT_DURATION_MS
                int "Max event handler duration in MS"
                default 500
                help
                    The maximum duration an event handler is allowed to run.
        endmenu
        menu "Protocols"
            config WALTER_MODEM_ENABLE_SOCKETS
                bool "Enable Socket functions"
                default y
                help
                    Enable socket functions.

            if WALTER_MODEM_ENABLE_SOCKETS
                menu "Socket (TCP/UDP)"
                    config WALTER_MODEM_MAX_SOCKETS
                        int "Max socket connections"
                        range 1 6
                        default 6
                        help
                            The maximum number of sockets.
                endmenu
            endif

            config WALTER_MODEM_ENABLE_MQTT
                bool "Enable MQTT functions"
                default y
                help
                    Enable MQTT support for the WalterModem.
            
            if WALTER_MODEM_ENABLE_MQTT
                menu "MQTT"                                        
                    config WALTER_MODEM_MQTT_MIN_PREF_KEEP_ALIVE
                        int "minimum keep alive time"
                        default 20
                        help
                            The recommended minimum for the mqtt keep alive time

                    config WALTER_MODEM_MQTT_MAX_TOPICS
                        int "max MQTT topics the modem can subscribe to"
                        default 4
                        help
                            The maximum allowed mqtt topics to subscribe to.
                endmenu
            endif

            config WALTER_MODEM_ENABLE_GNSS
                bool "Enable GNSS functions"
                default y
                help
                    Enable GNSS ofloading functions.
            
            if WALTER_MODEM_ENABLE_GNSS
                menu "GNSS"
                    config WALTER_MODEM_GNSS_MAX_SATS
                        int "Max tracked sats"
                        default 32
                        help
                            The maximum number of tracked GNSS satellites.
                endmenu
            endif

            config WALTER_MODEM_ENABLE_HTTP
                bool "Enable HTTP functions"
                default y
                help
                    Enable HTTP ofloading functions.
            
            if WALTER_MODEM_ENABLE_HTTP
                menu "HTTP"
                    config WALTER_MODEM_MAX_HTTP_PROFILES
                        int "Max http profiles"
                        range 1 3
                        default 3
                        help
                            The maximum number of HTTP profiles that the library can support.
                endmenu
            endif
            
            config WALTER_MODEM_ENABLE_COAP
                bool "Enable CoAP functions"
                default y
                help
                    Enable CoAP ofloading functions

            if WALTER_MODEM_ENABLE_COAP
                menu "CoAP"
                    config WALTER_MODEM_MAX_COAP_PROFILES
                        int "Max CoAP profiles"
                        default 3
                        range 1 3
                        help
                            The maximum number of CoAP profiles that the library can support.
                endmenu

                config WALTER_MODEM_ENABLE_BLUECHERRY
                    bool "Enable BlueCherry IoT functionality"
                    default y
                    select WALTER_MODEM_ENABLE_MOTA
                    help
                        Enable BlueCherry IoT functionality
                
                if WALTER_MODEM_ENABLE_BLUECHERRY
                    menu "Bluecherry"
                        comment "Mota and OTA functions are forced on when BlueCherry is enabled!"
                        
                        config WALTER_MODEM_BLUECHERRY_HOSTNAME
                            string "bluecherry server hostname"
                            default coap.bluecherry.io
                            help
                                The hostname to use for Bluecherry.

                        config WALTER_MODEM_BLUECHERRY_PORT
                            int "bluecherry server port"
                            default 5684
                            help
                                The port to use for Bluecherry
                    endmenu
                endif
            endif


        endmenu
        menu "Pinout"
            if WALTER_MODEM_KCONFIG
                config WALTER_MODEM_PIN_RX
                    int "RX"
                    default 14
                    help
                        The RX pin on which modem data is received.

                config WALTER_MODEM_PIN_TX
                    int "TX"
                    default 48
                    help
                        The TX to which modem data must be transmitted.
                
                config WALTER_MODEM_PIN_RTS
                    int "RTS"
                    default 21
                    help
                        The RTS pin on the ESP32 side.
                
                config WALTER_MODEM_PIN_CTS
                    int "CTS"
                    default 47
                    help
                        The CTS pin on the ESP32 size.
                    
                config WALTER_MODEM_PIN_RESET
                    int "Reset pin"
                    default 45
                    help
                        The active low modem reset pin.
            endif
        endmenu
        menu "UART"
            config WALTER_MODEM_BAUD
                int "The modem BAUD rate"
                default 115200
                help 
                    The baud rate used to talk to the modem.
            
            config UART_BUF_SIZE
                int "Uart buffer size"
                default 128
                help
                    The uart buffer size for modem communication.

            config UART_BUF_THRESHOLD
                int "Uart hardware flow control threshold size"
                default 122
                help
                    The hardware flow control buffer threshold size for modem communication
        endmenu
        menu "CMD settings"
            config WALTER_MODEM_CMD_TIMEOUT_MS
                int "Default cmd timeout in MS"
                default 30000
                help
                    The maximum number of milliseconds to wait before a command is considered timed out.
            
            config WALTER_MODEM_CMD_QUEUE_MAX_ITEMS
                int "The maximum commands that can be pending at one moment"
                range 8 64
                default 8
                help
                    The maximum number of pending commands. 
            
            config WALTER_MODEM_DEFAULT_CMD_ATTEMPTS
                int "Number of attempts to execute a command"
                default 3
                range 1 6
                help
                    The default number of attempts to execute a command.

            config WALTER_MODEM_CMD_TASK_STACK_SIZE
                int "The stack size of the modem task in bytes"
                default 4096
                range 2048 8192
                help
                    The size of the stack of the command and response processing task.
        endmenu
        menu "Other"
            config WALTER_MODEM_BUFFER_POOL_SIZE
                int "Buffer pool size"
                range 4 16
                default 8
                help
                    The number of buffers in the buffer pool.
        endmenu
        menu "PDP"
            config WALTER_MODEM_MAX_PDP_CTXTS
                int "Maximum pdp context count"
                range 1 8
                default 8
                help
                    The maximum number of PDP contexts that the library can support.

            config WALTER_MODEM_APN_MAX_SIZE
                int "Maximum chars in APN"
                default 99
                range 10 99
                help
                    The maximum numbers of characters of the APN.
            
            config WALTER_MODEM_PDP_ADDR_MAX_SIZE
                int "Max chars in pdp addr"
                default 63
                help
                    The maximum number of characters in the string representation of the PDP address.
            
            config  WALTER_MODEM_PDP_AUTH_USER_MAX_SIZE
                int "Max chars in pdp username"
                default 63
                help
                    The maximum number of characters of a PDP context username.

            config WALTER_MODEM_PDP_AUTH_PASS_MAX_SIZE
                int "Max chars in pdp password"
                default 63
                help
                    The maximum number of characters of a PDP context password.

            config WALTER_MODEM_MAX_TLS_PROFILES
                int "Max tls profiles"
                range 1 3
                default 3
                help
                    The maximum number of TLS profiles that the library can support.
        endmenu
   
        menu "Firmware upgrade"
        if WALTER_MODEM_ENABLE_BLUECHERRY
            comment "BlueCherry has been enabled MOTA & OTA have been forced on!"
        endif
        config WALTER_MODEM_ENABLE_MOTA
            bool "Enable MOTA functionality (Modem firmware)"
            default y
            help
                Enable Modem firmware upgrade functions.
        endmenu
    endif
endmenu
```

## examples/bluecherry/main/Kconfig.projbuild
```kconfig
menu "Walter BlueCherry example"
    if WALTER_MODEM_KCONFIG
        config CELLULAR_APN
            string "Cellular APN"
            default ""
            help
                Set the cellular APN to connect to.
        config BC_DEVICE_TYPE
            string "BlueCherry Device type"
            default "walter01"
            help
                Set the BlueCherry Device type as found in the BlueApp.
        config BC_TLS_PROFILE
            int "Modem TLS profile ID for BlueCherry"
            default 1
            help
                Specify what TLS profile ID the modem will use to configure TLS communication with BlueCherry.
                It is recommended to not re-use this profile for other TLS-enabled communication.
    endif
endmenu
```

## examples/coap/main/Kconfig.projbuild
```kconfig
menu "coap example"
    if WALTER_MODEM_KCONFIG
        config CELLULAR_APN
            string "cellular apn"
            default ""
            help
                the apn to connect to

        config SEND_DELAY_MS
            int "data transmission delay"
            default 10000
            help
                the data transmission delay to the coap demo server

        config MODEM_COAP_PROFILE
            int "the COAP profile id"
            default 0
    endif
    
endmenu
```

## examples/coap/sdkconfig.defaults
```kconfig
CONFIG_IDF_TARGET="esp32s3"
CONFIG_IDF_TARGET_ESP32S3=y
CONFIG_FREERTOS_UNICORE=y
CONFIG_ESP_MAIN_TASK_STACK_SIZE=8192
CONFIG_LOG_DEFAULT_LEVEL_INFO=y
CONFIG_LOG_DEFAULT_LEVEL=3
CONFIG_PARTITION_TABLE_TWO_OTA=y
CONFIG_PARTITION_TABLE_FILENAME="partitions_two_ota.csv"
CONFIG_ESPTOOLPY_FLASH_MODE_AUTO_DETECT=n
CONFIG_ESPTOOLPY_FLASHMODE_QIO=y
CONFIG_ESPTOOLPY_FLASHSIZE_16MB=y
CONFIG_ESPTOOLPY_FLASHSIZE="16MB"
CONFIG_FLASHMODE_QIO=y
CONFIG_ESP_DEFAULT_CPU_FREQ_MHZ_240=y
CONFIG_ESP_DEFAULT_CPU_FREQ_MHZ=240
CONFIG_ESP_TASK_WDT_EN=y
CONFIG_ESP_TASK_WDT_INIT=y
CONFIG_ESP_TASK_WDT_PANIC=y
CONFIG_ESP_TASK_WDT_TIMEOUT_S=60
CONFIG_ESP_TASK_WDT_CHECK_IDLE_TASK_CPU0=y
CONFIG_ESP_TASK_WDT_CHECK_IDLE_TASK_CPU1=y
```

## examples/http/main/Kconfig.projbuild
```kconfig
menu "http example"
    if WALTER_MODEM_KCONFIG
        config CELLULAR_APN
            string "cellular apn"
            default ""
            help
                the apn to connect to

        config SEND_DELAY_MS
            int "data transmission delay"
            default 10000
            help
                the data transmission delay to the http demo server

        config MODEM_HTTP_PROFILE
            int "modem HTTP profile"
            range 1 6
            default 1
            help
                the tls profile for the MQTT connection.

        config MAX_RECEIVE_COUNT
            int "max http receive count"
            default 3
    endif
endmenu
```

## examples/mqtt/main/Kconfig.projbuild
```kconfig
menu "mqtt example"
    if WALTER_MODEM_KCONFIG
        config CELLULAR_APN
            string "cellular apn"
            default ""
            help
                the apn to connect to
        
        config SEND_DELAY_MS
            int "data transmission delay"
            default 10000
            help
                the data transmission delay to the mqtt demo server        
    endif
endmenu
```

## examples/socket_test/main/Kconfig.projbuild
```kconfig
menu "scoket Example"
    if WALTER_MODEM_KCONFIG
        config CELLULAR_APN
            string "cellular apn"
            default ""
            help
                the default apn to connect to
        
        config SERV_ADDR
            string "demo server address"
            default "walterdemo.quickspot.io"
            help
                the server address of the walter demo server
        
        config SERV_PORT
            int "demo server port"
            default 1999
            help
                the server port of the walter demo server
    endif  
endmenu
```

## examples/tcp/main/Kconfig.projbuild
```kconfig
menu "socket receive Example"
    if WALTER_MODEM_KCONFIG
        config CELLULAR_APN
            string "cellular apn"
            default ""
            help
                the apn to connect to
        
        config SEND_DELAY_MS
            int "data transmission delay"
            default 10000
            help
                the data transmission delay to the example.com server
        
        config SERV_ADDR
            string "demo server address"
            default "example.com"
            help
                the server address to receive and send to.
        
        config SERV_PORT
            int "demo server port"
            default 80
            help
                the server port of server to receive and send to.
        
        
    endif  
endmenu
```
