## examples/udp_socket/main/Kconfig.projbuild
```kconfig
menu "socket Example"
    if WALTER_MODEM_KCONFIG
        config CELLULAR_APN
            string "cellular apn"
            default ""
            help
                the apn to connect to
        
        config SEND_INTERVAL_MS
            int "data transmission interval"
            default 10000
            help
                the data transmission interval to the walter demo server
        
        config SERV_ADDR
            string "demo server address"
            default "walterdemo.quickspot.io"
            help
                the server address of the walter demo server
        
        config SERV_PORT
            int "demo server port"
            default 1999
            help
                the server port of the walter demo server
    endif  
endmenu
```
